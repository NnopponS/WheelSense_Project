## PaperIEEE/data-collection/firmware/station/sdkconfig.defaults
```kconfig
# BLE Station — sdkconfig.defaults
# Enables Bluedroid BLE-only stack
# These options are recognized by the ESP-IDF menuconfig / CMake build system.

CONFIG_BT_ENABLED=y
CONFIG_BTDM_CTRL_MODE_BLE_ONLY=y
CONFIG_BT_BLUEDROID_ENABLED=y
CONFIG_BT_CLASSIC_ENABLED=n

# Disable unused Bluetooth features to save RAM
CONFIG_BT_BLE_DYNAMIC_ENV_MEMORY=n

# Enable BLE 4.2 features for old gap APIs (esp_ble_gap_start_scanning)
CONFIG_BT_BLE_42_FEATURES_SUPPORTED=y

# Use custom partition table with larger app partition
CONFIG_PARTITION_TABLE_CUSTOM=y
CONFIG_PARTITION_TABLE_CUSTOM_FILENAME="partitions.csv"
```
